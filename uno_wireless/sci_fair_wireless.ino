#include <SoftwareSerial.h>
#define rxPin 11
#define txPin 10
SoftwareSerial bluetooth(rxPin, txPin);
#include <Wire.h>
#include <Adafruit_GFX.h>
#include <Adafruit_SSD1306.h>

#define OLED_RESET 4
Adafruit_SSD1306 display(128, 64, &Wire, OLED_RESET);

char keyword;
// 'hello', 128x64px
const unsigned char hello [] PROGMEM = {
  0xff, 0xff, 0xff, 0xff, 0xff, 0xff, 0xff, 0xff, 0xff, 0xff, 0xff, 0xff, 0xff, 0xff, 0xff, 0xff, 
  0xff, 0xff, 0xff, 0xff, 0xff, 0xff, 0xff, 0xff, 0xff, 0xff, 0xff, 0xff, 0xff, 0xff, 0xff, 0xff, 
  0xff, 0xff, 0xff, 0xff, 0xff, 0xff, 0xff, 0xff, 0xff, 0xff, 0xff, 0xff, 0xff, 0xff, 0xff, 0xff, 
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  0xff, 0xff, 0xff, 0xff, 0xff, 0xff, 0xff, 0xff, 0xff, 0xff, 0xff, 0xff, 0xff, 0xff, 0xff, 0xff
};
// 'thanks', 128x64px
const unsigned char thanks [] PROGMEM = {
  0xff, 0xff, 0xff, 0xff, 0xff, 0xff, 0xff, 0xff, 0xff, 0xff, 0xff, 0xff, 0xff, 0xff, 0xff, 0xff, 
  0xff, 0xff, 0xff, 0xff, 0xff, 0xff, 0xff, 0xff, 0xff, 0xff, 0xff, 0xff, 0xff, 0xff, 0xff, 0xff, 
  0xff, 0xff, 0xff, 0xff, 0xff, 0xff, 0xff, 0xff, 0xff, 0xff, 0xff, 0xff, 0xff, 0xff, 0xff, 0xff, 
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  0xff, 0xff, 0xff, 0xff, 0xff, 0xff, 0xff, 0xff, 0xff, 0xff, 0xff, 0xff, 0xff, 0xff, 0xff, 0xff
};
// 'goodbye', 128x64px
const unsigned char goodbye [] PROGMEM = {
  0xff, 0xff, 0xff, 0xff, 0xff, 0xff, 0xff, 0xff, 0xff, 0xff, 0xff, 0xff, 0xff, 0xff, 0xff, 0xff, 
  0xff, 0xff, 0xff, 0xff, 0xff, 0xff, 0xff, 0xff, 0xff, 0xff, 0xff, 0xff, 0xff, 0xff, 0xff, 0xff, 
  0xff, 0xff, 0xff, 0xff, 0xff, 0xff, 0xff, 0xff, 0xff, 0xff, 0xff, 0xff, 0xff, 0xff, 0xff, 0xff, 
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  0xff, 0xff, 0xff, 0xff, 0xff, 0xff, 0xff, 0xff, 0xff, 0xff, 0xff, 0xff, 0xff, 0xff, 0xff, 0xff
};
// 'welcome', 128x64px
const unsigned char welcome [] PROGMEM = {
  0xff, 0xff, 0xff, 0xff, 0xff, 0xff, 0xff, 0xff, 0xff, 0xff, 0xff, 0xff, 0xff, 0xff, 0xff, 0xff, 
  0xff, 0xff, 0xff, 0xff, 0xff, 0xff, 0xff, 0xff, 0xff, 0xff, 0xff, 0xff, 0xff, 0xff, 0xff, 0xff, 
  0xff, 0xff, 0xff, 0xff, 0xff, 0xff, 0xff, 0xff, 0xff, 0xff, 0xff, 0xff, 0xff, 0xff, 0xff, 0xff, 
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  0xff, 0xff, 0xff, 0xff, 0xff, 0xff, 0xff, 0xff, 0xff, 0xff, 0xff, 0xff, 0xff, 0xff, 0xff, 0xff
};


void setup() {
  Serial.begin(9600);
  bluetooth.begin(9600);
  display.begin(SSD1306_SWITCHCAPVCC, 0x3c);
  display.setTextColor(WHITE);
}
void drawBitmap_hello(int x, int y)
{
  display.drawBitmap(x, y, hello, 128, 64, WHITE);
}
void drawBitmap_thanks(int x, int y)
{
  display.drawBitmap(x, y, thanks, 128, 64, WHITE);
}
void drawBitmap_goodbye(int x, int y)
{
  display.drawBitmap(x, y, goodbye, 128, 64, WHITE);
}
void drawBitmap_welcome(int x, int y)
{
  display.drawBitmap(x, y, welcome, 128, 64, WHITE);
}
void loop() {
  if (bluetooth.available() > 0)
  {
    char keyword = bluetooth.read();
    if (keyword== '1')
    {
      display.clearDisplay();
      drawBitmap_hello(0, 0);
      display.display();
      delay(1000);
      display.clearDisplay();
      display.display();
    }
    if (keyword== '2')
    {
      display.clearDisplay();
      drawBitmap_thanks(0, 0);
      display.display();
      delay(1000);
      display.clearDisplay();
      display.display();
    }
    if (keyword== '3')
    {
      display.clearDisplay();
      drawBitmap_goodbye(0, 0);
      display.display();
      delay(1000);
      display.clearDisplay();
      display.display();
    }
    if (keyword== '4')
    {
      display.clearDisplay();
      drawBitmap_welcome(0, 0);
      display.display();
      delay(1000);
      display.clearDisplay();
      display.display();
    }
  }
}
